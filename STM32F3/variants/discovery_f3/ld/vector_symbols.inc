EXTERN(__msp_init)
EXTERN(__exc_reset)
EXTERN(__exc_nmi)
EXTERN(__exc_hardfault)
EXTERN(__exc_memmanage)
EXTERN(__exc_busfault)
EXTERN(__exc_usagefault)
EXTERN(__stm32reservedexception7)
EXTERN(__stm32reservedexception8)
EXTERN(__stm32reservedexception9)
EXTERN(__stm32reservedexception10)
EXTERN(__exc_svc)
EXTERN(__exc_debug_monitor)
EXTERN(__stm32reservedexception13)
EXTERN(__exc_pendsv)
EXTERN(__exc_systick)
EXTERN(__irq_wwdg)
EXTERN(__irq_pvd)
EXTERN(__irq_tamp_stamp)
EXTERN(__irq_rtc_wkup)
EXTERN(__irq_flash)
EXTERN(__irq_rcc)
EXTERN(__irq_exti0)
EXTERN(__irq_exti1)
EXTERN(__irq_exti2)
EXTERN(__irq_exti3)
EXTERN(__irq_exti4)
EXTERN(__irq_dma1_ch1)
EXTERN(__irq_dma1_ch2)
EXTERN(__irq_dma1_ch3)
EXTERN(__irq_dma1_ch4)
EXTERN(__irq_dma1_ch5)
EXTERN(__irq_dma1_ch6)
EXTERN(__irq_dma1_ch7)
EXTERN(__irq_adc1_2)
EXTERN(__irq_usb_hp_can_tx)
EXTERN(__irq_usb_lp_can_rx0)
EXTERN(__irq_can_rx1)
EXTERN(__irq_can_sce)
EXTERN(__irq_exti9_5)
EXTERN(__irq_tim1_brk_tim15)
EXTERN(__irq_tim1_up_tim16)
EXTERN(__irq_tim1_trg_com_tim17)
EXTERN(__irq_tim1_cc)
EXTERN(__irq_tim2)
EXTERN(__irq_tim3)
EXTERN(__irq_tim4)
EXTERN(__irq_i2c1_ev)
EXTERN(__irq_i2c1_er)
EXTERN(__irq_i2c2_ev)
EXTERN(__irq_i2c2_er)
EXTERN(__irq_spi1)
EXTERN(__irq_spi2)
EXTERN(__irq_usart1)
EXTERN(__irq_usart2)
EXTERN(__irq_usart3)
EXTERN(__irq_exti15_10)
EXTERN(__irq_rtc_alarm)
EXTERN(__irq_usb_wkup)
EXTERN(__irq_tim8_brk)
EXTERN(__irq_tim8_up)
EXTERN(__irq_tim8_trg_com)
EXTERN(__irq_tim8_cc)
EXTERN(__irq_adc3)
EXTERN(__stm32reservedexception48)
EXTERN(__stm32reservedexception49)
EXTERN(__stm32reservedexception50)
EXTERN(__irq_spi3)
EXTERN(__irq_uart4)
EXTERN(__irq_uart5)
EXTERN(__irq_tim6_dacunder)
EXTERN(__irq_tim7)
EXTERN(__irq_dma2_ch1)
EXTERN(__irq_dma2_ch2)
EXTERN(__irq_dma2_ch3)
EXTERN(__irq_dma2_ch4)
EXTERN(__irq_dma2_ch5)
EXTERN(__irq_adc4)
EXTERN(__stm32reservedexception62)
EXTERN(__stm32reservedexception63)
EXTERN(__irq_comp123)
EXTERN(__irq_comp456)
EXTERN(__irq_comp7)
EXTERN(__stm32reservedexception67)
EXTERN(__stm32reservedexception68)
EXTERN(__stm32reservedexception69)
EXTERN(__stm32reservedexception70)
EXTERN(__stm32reservedexception71)
EXTERN(__stm32reservedexception72)
EXTERN(__stm32reservedexception73)
EXTERN(__irq_usb_hp)
EXTERN(__irq_usb_lp)
EXTERN(__irq_usb_wkup2)
EXTERN(__stm32reservedexception77)
EXTERN(__stm32reservedexception78)
EXTERN(__stm32reservedexception79)
EXTERN(__stm32reservedexception80)
EXTERN(__irq_fpu)
