EXTERN(__msp_init)
EXTERN(__exc_reset)
EXTERN(__exc_nmi)
EXTERN(__exc_hardfault)
EXTERN(__exc_memmanage)
EXTERN(__exc_busfault)
EXTERN(__exc_usagefault)
EXTERN(__stm32reservedexception7)
EXTERN(__stm32reservedexception8)
EXTERN(__stm32reservedexception9)
EXTERN(__stm32reservedexception10)
EXTERN(__exc_svc)
EXTERN(__exc_debug_monitor)
EXTERN(__stm32reservedexception13)
EXTERN(__exc_pendsv)
EXTERN(__exc_systick)

EXTERN(__irq_wwdg)
EXTERN(__irq_pvd)
EXTERN(__irq_tamp_stamp)
EXTERN(__irq_rtc_wkup)
EXTERN(__irq_flash)
EXTERN(__irq_rcc)
EXTERN(__irq_exti0)
EXTERN(__irq_exti1)
EXTERN(__irq_exti2)
EXTERN(__irq_exti3)
EXTERN(__irq_exti4)
EXTERN(__irq_dma1_stream0)
EXTERN(__irq_dma1_stream1)
EXTERN(__irq_dma1_stream2)
EXTERN(__irq_dma1_stream3)
EXTERN(__irq_dma1_stream4)
EXTERN(__irq_dma1_stream5)
EXTERN(__irq_dma1_stream6)
EXTERN(__irq_adc)
EXTERN(__irq_can1_tx)
EXTERN(__irq_can1_rx0)
EXTERN(__irq_can1_rx1)
EXTERN(__irq_can1_sce)
EXTERN(__irq_exti9_5)
EXTERN(__irq_tim1_brk_tim9)
EXTERN(__irq_tim1_up_tim10)
EXTERN(__irq_tim1_trg_com_tim11)
EXTERN(__irq_tim1_cc)
EXTERN(__irq_tim2)
EXTERN(__irq_tim3)
EXTERN(__irq_tim4)
EXTERN(__irq_i2c1_ev)
EXTERN(__irq_i2c1_er)
EXTERN(__irq_i2c2_ev)
EXTERN(__irq_i2c2_er)
EXTERN(__irq_spi1)
EXTERN(__irq_spi2)
EXTERN(__irq_usart1)
EXTERN(__irq_usart2)
EXTERN(__irq_usart3)
EXTERN(__irq_exti15_10)
EXTERN(__irq_rtc_alarm)
EXTERN(__irq_otg_fs_wkup)
EXTERN(__irq_tim8_brk_tim12)
EXTERN(__irq_tim8_up_tim13)
EXTERN(__irq_tim8_trg_com_tim14)
EXTERN(__irq_tim8_cc)
EXTERN(__irq_dma1_stream7)
EXTERN(__irq_fsmc)
EXTERN(__irq_sdio)
EXTERN(__irq_tim5)
EXTERN(__irq_spi3)
EXTERN(__irq_uart4)
EXTERN(__irq_uart5)
EXTERN(__irq_tim6_dac)
EXTERN(__irq_tim7)
EXTERN(__irq_dma2_stream0)
EXTERN(__irq_dma2_stream1)
EXTERN(__irq_dma2_stream2)
EXTERN(__irq_dma2_stream3)
EXTERN(__irq_dma2_stream4)
EXTERN(__irq_eth)
EXTERN(__irq_eth_wkup)
EXTERN(__irq_can2_tx)
EXTERN(__irq_can2_rx0)
EXTERN(__irq_can2_rx1)
EXTERN(__irq_can2_sce)
EXTERN(__irq_otg_fs)
EXTERN(__irq_dma2_stream5)
EXTERN(__irq_dma2_stream6)
EXTERN(__irq_dma2_stream7)
EXTERN(__irq_usart6)
EXTERN(__irq_i2c3_ev)
EXTERN(__irq_i2c3_er)
EXTERN(__irq_otg_hs_ep1_out)
EXTERN(__irq_otg_hs_ep1_in)
EXTERN(__irq_otg_hs_wkup)
EXTERN(__irq_otg_hs)
EXTERN(__irq_dcmi)
EXTERN(__irq_cryp)
EXTERN(__irq_hash_rng)
